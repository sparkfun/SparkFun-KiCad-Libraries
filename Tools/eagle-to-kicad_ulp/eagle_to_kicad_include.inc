// Glboba defs for the 4 ulps

string BUILD_DATE = "20-April-2017";

string cfg_LIBS = "Eagle.To.KiCad.Libs.LIBS";
string cfg_conflictPartsLibsListsize = "Eagle.To.KiCad.Libs.conflictPartsLibsListsize";
string cfg_addLibPrefix = "Eagle.To.KiCad.Libs.addLibPrefix";
string cfg_SCRIPT_ULP = "Eagle.To.KiCad.Libs.SCRIPT_ULP";
string cfg_TARGET_DIR = "Eagle.To.KiCad.Libs.TARGET_DIR";
string cfg_F0 = "Eagle.To.KiCad.Libs.SCHf0.REF.SCALING";
string cfg_F1 = "Eagle.To.KiCad.Libs.SCHf1.VALUE.SCALING";
string cfg_F2 = "Eagle.To.KiCad.Libs.SCHf2.NAME.SCALING";
string cfg_EnableNetLableFix = "Eagle.To.KiCad.Libs.SCH.NET.LABLE.FIX";
string cfg_CombinedLrbFileName = "Eagle.To.KiCad.Libs.CombinedLrbFileName";
string cfg_ConversionLogFileName ="Eagle.To.KiCad.Libs.ConversionLogFileName";
